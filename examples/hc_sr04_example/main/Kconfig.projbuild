## examples/hc_sr04_example/main/Kconfig.projbuild
```kconfig
menu "HC-SR04 Example Configuration"
    orsource "$IDF_PATH/examples/common_components/env_caps/$IDF_TARGET/Kconfig.env_caps"

    config TRIG_GPIO 
        int "GPIO trig pin"
        range ENV_GPIO_RANGE_MIN ENV_GPIO_OUT_RANGE_MAX
        default 14
        help 
            GPIO pin number connected to HC-SR04 trigger pin

    config ECHO_GPIO 
        int "GPIO echo pin"
        range ENV_GPIO_RANGE_MIN ENV_GPIO_OUT_RANGE_MAX
        default 12
        help 
            GPIO pin number connected to HC-SR04 echo pin
endmenu
```
